## arch/arm/mach-pvmfw/Kconfig
```kconfig
if ARCH_PVMFW

config SYS_VENDOR
	default "android"

config SYS_BOARD
	default "pvmfw-arm64"

config SYS_CONFIG_NAME
	default "pvmfw-arm64"

config TARGET_PVMFW_ARM_64BIT
	bool "ARMv8, 64bit"
	default y
	select ARM64

config SYS_SDRAM_BASE
	hex "SDRAM base address"
	default 0x40000000
	help
	  The address that is start of SDRAM.

endif
```

## board/armltd/vexpress64/Kconfig
```kconfig
if TARGET_VEXPRESS64_BASE_FVP || TARGET_VEXPRESS64_GEM5 || TARGET_VEXPRESS64_JUNO

config SYS_BOARD
	default "vexpress64"

config SYS_VENDOR
	default "armltd"

config SYS_CONFIG_NAME
	default "vexpress_aemv8"

if TARGET_VEXPRESS64_GEM5

config BOARD_SPECIFIC_OPTIONS # dummy
	def_bool y
	imply VIRTIO_MMIO
	imply VIRTIO_PCI
	imply VIRTIO_NET
	imply VIRTIO_BLK

config SYS_EARLY_PCI_INIT
	def_bool y

config SYS_FDT_ADDR
	hex "FDT load address"
	default 0x88000000
	help
	  On vexpress_gem5, the physical address of a preloaded device
          tree blob to configure U-Boot.

# gem5 really needs 0x10, but this is handled in the linker script
# because SYS_TEXT_BASE is required to be page aligned
config SYS_TEXT_BASE
	default 0x00000000

endif

if TARGET_VEXPRESS64_JUNO

config JUNO_DTB_PART
	string "NOR flash partition holding DTB"
	default "board.dtb"
	help
	  The ARM partition name in the NOR flash memory holding the
	  device tree blob to configure U-Boot.

endif

endif
```

## board/xen/xenguest_android_arm64/Kconfig
```kconfig
if TARGET_XENGUEST_ANDROID_ARM64

config SYS_BOARD
	default "xenguest_android_arm64"

config SYS_VENDOR
	default "xen"

config SYS_CONFIG_NAME
	default "xenguest_android_arm64"

config LNX_KRNL_IMG_TEXT_OFFSET_BASE
	default SYS_LOAD_ADDR

endif
```

## board/xen/xenguest_arm64_android/Kconfig
```kconfig
if TARGET_XENGUEST_ARM64_ANDROID

config SYS_BOARD
	default "xenguest_arm64_android"

config SYS_VENDOR
	default "xen"

config SYS_CONFIG_NAME
	default "xenguest_arm64_android"

config LNX_KRNL_IMG_TEXT_OFFSET_BASE
	default SYS_LOAD_ADDR

endif
```

## configs/cf-x86_defconfig
```kconfig
CONFIG_X86=y
CONFIG_SYS_TEXT_BASE=0xFFF00000
CONFIG_NR_DRAM_BANKS=8
CONFIG_ENV_SIZE=0x1000
CONFIG_MAX_CPUS=2
CONFIG_DEFAULT_DEVICE_TREE="qemu-x86_i440fx"
CONFIG_SMP=y
CONFIG_GENERATE_PIRQ_TABLE=y
CONFIG_GENERATE_MP_TABLE=y
CONFIG_GENERATE_ACPI_TABLE=y
CONFIG_ANDROID_BOOT_IMAGE=y
CONFIG_SYS_CONSOLE_INFO_QUIET=y
CONFIG_DISPLAY_BOARDINFO_LATE=y
CONFIG_LAST_STAGE_INIT=y
CONFIG_ANDROID_AB=y
CONFIG_HUSH_PARSER=y
CONFIG_CMD_CPU=y
CONFIG_CMD_GPT=y
# CONFIG_RANDOM_UUID is not set
CONFIG_CMD_PART=y
# CONFIG_CMD_SETEXPR is not set
CONFIG_CMD_DHCP=y
# CONFIG_CMD_NFS is not set
CONFIG_CMD_PING=y
CONFIG_CMD_TIME=y
CONFIG_CMD_QFW=y
CONFIG_CMD_EXT2=y
CONFIG_CMD_EXT4=y
CONFIG_CMD_EXT4_WRITE=y
CONFIG_CMD_FAT=y
CONFIG_CMD_FS_GENERIC=y
CONFIG_ENV_IS_IN_RAW_DISK=y
CONFIG_ENV_RAW_DISK_INTERFACE="virtio"
CONFIG_ENV_RAW_DISK_DEVICE_AND_PART="0:1"
CONFIG_REGMAP=y
CONFIG_SYSCON=y
CONFIG_CPU=y
# CONFIG_X86_PCH7 is not set
# CONFIG_X86_PCH9 is not set
# CONFIG_EFI_LOADER is not set
```

## configs/xenguest_android_arm64_defconfig
```kconfig
CONFIG_ARM=y
CONFIG_POSITION_INDEPENDENT=y
CONFIG_TEXT_BASE=0x40080000
CONFIG_SYS_MALLOC_F_LEN=0x2000
CONFIG_IDENT_STRING=" xenguest"
CONFIG_TARGET_XENGUEST_ANDROID_ARM64=y
CONFIG_BOOTDELAY=3
CONFIG_ANDROID_BOOT_IMAGE=y
CONFIG_FASTBOOT_BUF_ADDR=0x82000000
CONFIG_FASTBOOT_BUF_SIZE=0x2F000000

CONFIG_PARTITIONS=y
CONFIG_MMC=y
CONFIG_CMD_BCB=y

CONFIG_ANDROID_AB=y
CONFIG_CMD_AB_SELECT=y

CONFIG_LIBAVB=y
CONFIG_AVB_VERIFY=y
CONFIG_CMD_AVB=y
CONFIG_PARTITION_UUIDS=y
CONFIG_FASTBOOT=y
CONFIG_UDP_FUNCTION_FASTBOOT=y
CONFIG_NET=y
CONFIG_CMD_NET=y
CONFIG_CMD_BOOTP=y

CONFIG_HUSH_PARSER=y
CONFIG_CMD_PART=y


CONFIG_SYS_PROMPT="xenguest# "

CONFIG_CMD_BOOTD=n
CONFIG_CMD_BOOTEFI=n
CONFIG_CMD_BOOTEFI_HELLO_COMPILE=n
CONFIG_CMD_ELF=n
CONFIG_CMD_EXT4=y
CONFIG_CMD_FAT=y
CONFIG_CMD_GO=n
CONFIG_CMD_IMI=n
CONFIG_CMD_IMLS=n
CONFIG_CMD_XIMG=n
CONFIG_CMD_EXPORTENV=n
CONFIG_CMD_IMPORTENV=n
CONFIG_CMD_EDITENV=n
CONFIG_CMD_ENV_EXISTS=y
CONFIG_CMD_MEMORY=y
CONFIG_CMD_CRC32=n
CONFIG_CMD_DM=y
CONFIG_CMD_LOADB=n
CONFIG_CMD_LOADS=n
CONFIG_CMD_FLASH=n
CONFIG_CMD_GPT=y
CONFIG_CMD_FPGA=n
CONFIG_CMD_ECHO=y
CONFIG_CMD_ITEST=n
CONFIG_CMD_SOURCE=n
CONFIG_CMD_SETEXPR=y
CONFIG_CMD_MISC=n
CONFIG_CMD_UNZIP=n
CONFIG_CMD_LZMADEC=n
CONFIG_CMD_SAVEENV=n
CONFIG_CMD_UMS=n

CONFIG_CMD_PVBLOCK=y
CONFIG_CMD_MMC=y

#CONFIG_USB=n
# CONFIG_ISO_PARTITION is not set

CONFIG_EFI_PARTITION=y
# CONFIG_EFI_LOADER is not set

CONFIG_DM=y
CONFIG_DM_SERIAL=y
CONFIG_DM_MMC=y
# CONFIG_REQUIRE_SERIAL_CONSOLE is not set

CONFIG_OF_BOARD=y
CONFIG_OF_LIBFDT=y

# 30 Mb
CONFIG_SYS_BOOTM_LEN=0x1E00000

# CONFIG_SYS_SDRAM_BASE is not set
CONFIG_NR_DRAM_BANKS=1

#
# This can be any arbitrary address as we are using PIE, but
# please note, that CONFIG_TEXT_BASE must match the below.
#
CONFIG_SYS_LOAD_ADDR=0x40000000

# Size of malloc() pool
# 32 Mb
CONFIG_SYS_MALLOC_LEN=0x2000000

CONFIG_OF_SYSTEM_SETUP=y

CONFIG_DEFAULT_DEVICE_TREE="xenguest-android-arm64"
CONFIG_CMD_MEMTEST=y
CONFIG_CMD_BDI=y
CONFIG_ANDROID_PERSISTENT_RAW_DISK_DEVICE=0
CONFIG_IOMMU=y

# Override of the configuration from the cuttlefish.fragment
# CONFIG_USE_DEFAULT_ENV_FILE is not set
# CONFIG_DEFAULT_ENV_FILE is not set

CONFIG_SYS_MAXARGS=64
CONFIG_SYS_PBSIZE=1051
```

## drivers/firmware/Kconfig
```kconfig
config FIRMWARE
	bool "Enable Firmware driver support"

config SPL_FIRMWARE
	bool "Enable Firmware driver support in SPL"
	depends on FIRMWARE

config SPL_ARM_PSCI_FW
	bool
	select SPL_FIRMWARE

config ARM_PSCI_FW
	bool
	select FIRMWARE

config KVM_HYP_SERVICES
	bool "KVM hypervisor services"
	depends on ARM_PSCI_FW
	help
	  When running inside a KVM guest, the hypervisor may provide
	  hypercalls which are discoverable via the SMCCC feature probing
	  mechanism.

	  Say yes to enable support for discovering these services and making
	  use of them where necessary.

config TI_SCI_PROTOCOL
	tristate "TI System Control Interface (TISCI) Message Protocol"
	depends on K3_SEC_PROXY
	select FIRMWARE
	select SPL_FIRMWARE if SPL
	help
	  TI System Control Interface (TISCI) Message Protocol is used to manage
	  compute systems such as ARM, DSP etc with the system controller in
	  complex System on Chip (SoC) such as those found on certain K3
	  generation SoC from TI.

	  This protocol library is used by client drivers to use the features
	  provided by the system controller.

config ZYNQMP_FIRMWARE
	bool "ZynqMP Firmware interface"
	select FIRMWARE
	help
	  Firmware interface driver is used by different
	  drivers to communicate with the firmware for
	  various platform management services.
	  Say yes to enable ZynqMP firmware interface driver.
	  If in doubt, say N.

source "drivers/firmware/scmi/Kconfig"
```

## drivers/reserved-mem/Kconfig
```kconfig
config DICE_RMEM
	bool "DICE reserved memory region driver"
	help
	  Device Identifier Composition Engine is a measured boot protocol used
	  for remote attestation and key provisioning. This device driver binds
	  to the reserved memory region used for handing over data from one
	  boot stage to another.
```
